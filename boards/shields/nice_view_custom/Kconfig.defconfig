## boards/shields/nice_view_custom/Kconfig.defconfig
```kconfig
# Copyright (c) 2023 The ZMK Contributors
# SPDX-License-Identifier: MIT

if SHIELD_NICE_VIEW_CUSTOM

config LV_Z_VDB_SIZE
    default 100

config LV_DPI_DEF
    default 161

config LV_Z_BITS_PER_PIXEL
    default 1

choice LV_COLOR_DEPTH
    default LV_COLOR_DEPTH_1
endchoice

choice ZMK_DISPLAY_WORK_QUEUE
    default ZMK_DISPLAY_WORK_QUEUE_DEDICATED
endchoice

choice ZMK_DISPLAY_STATUS_SCREEN
    default ZMK_DISPLAY_STATUS_SCREEN_CUSTOM
endchoice

config LV_Z_MEM_POOL_SIZE
    default 4096 if ZMK_DISPLAY_STATUS_SCREEN_CUSTOM

config ZMK_DISPLAY_STATUS_SCREEN_CUSTOM
    imply NICE_VIEW_WIDGET_STATUS

config NICE_VIEW_WIDGET_STATUS
    bool "Custom nice!view status widget"
    select LV_FONT_MONTSERRAT_16
    select LV_USE_IMG
    select LV_USE_CANVAS

config NICE_VIEW_WIDGET_INVERTED
    bool "Invert custom status widget colors"

config NICE_VIEW_CUSTOM_ART_SET
    int "Right-hand art set to show (-1 = random each power-on)"
    default -1

config NICE_VIEW_CUSTOM_ANIMATE
    bool "Animate multi-frame art sets while the keyboard is active"

config FOXGLOVE_SPLIT_GUARD
    bool "Drop and retry a split link that hasn't encrypted within 20 s (#122)"
    default y
    depends on NICE_VIEW_ART_RELAY
    help
      A link to the right half that stays below security L2 never gets ZMK's split service
      set up, so the right doesn't type. The guard disconnects it so ZMK reconnects, at most 3
      times in a row, with a log line and a count in HELLO. On in dev and GA builds: the
      forced recovery case (D7 0B, #81) passed on hardware.

config FOXGLOVE_RIGHT_TX_0DBM
    bool "Right half: transmit at 0 dBm instead of +8 dBm (#218)"
    default y
    help
      The right half's only link is the split link to the left, a few centimetres away, so +8 dBm
      only costs battery. The left keeps +8 dBm for the PC. Turn this off if the split link drops
      (the guard counter in HELLO byte 31 is the first sign).

# Defaults only: a CONFIG_BT_CTLR_TX_PWR_* line in a .conf still wins.
choice BT_CTLR_TX_PWR
    default BT_CTLR_TX_PWR_0 if FOXGLOVE_RIGHT_TX_0DBM && ZMK_SPLIT && !ZMK_SPLIT_ROLE_CENTRAL
    default BT_CTLR_TX_PWR_PLUS_8
endchoice

config FOXGLOVE_TEST_HOOKS
    bool "Foxglove pre-GA test hooks"
    default y
    help
      Pre-GA test hooks for injecting key positions through the real keymap and split link.
      The GA build turns this off.

config FOXGLOVE_LAMP_STRIP
    bool "Let the PC drive this half's underglow (for the HID LampArray, #88)"
    default y if NICE_VIEW_RGB_IDLE && NICE_VIEW_ART_RELAY && ZMK_SPLIT && !ZMK_SPLIT_ROLE_CENTRAL
    default y if FOXGLOVE_LAMPARRAY
    depends on NICE_VIEW_RGB_IDLE

config FOXGLOVE_LAMPARRAY
    bool "HID LampArray on USB for Windows Dynamic Lighting (prototype, #88)"
    depends on USB_DEVICE_HID && NICE_VIEW_RGB_IDLE && (!ZMK_SPLIT || ZMK_SPLIT_ROLE_CENTRAL)
    help
      Needs one more USB HID device: raise USB_HID_DEVICE_COUNT by one.

config FOXGLOVE_LAMPARRAY_BLE
    bool "Also offer the LampArray over Bluetooth (HID over GATT, prototype, #88)"
    depends on FOXGLOVE_LAMPARRAY && ZMK_BLE
    help
      A second HID service on the left with the same six feature reports. Whether Windows
      Dynamic Lighting takes a LampArray over Bluetooth is unverified; dev builds only until the
      #115 sitting says so. Adding a GATT service can make a bonded PC need pairing again.

config FOXGLOVE_LAMPARRAY_DEVICE
    string "USB HID device for the LampArray"
    default "HID_2"
    depends on FOXGLOVE_LAMPARRAY

config NICE_VIEW_HOST_LINK
    bool "PC-driven host panel on the left screen (Raw HID)"
    default y if RAW_HID
    depends on RAW_HID

config NICE_VIEW_HOST_PANEL_TIMEOUT_S
    int "Seconds without a host panel report before the WPM chart comes back (0 = never)"
    default 0
    range 0 3600
    depends on NICE_VIEW_HOST_LINK
    help
      With 0 the left screen keeps the last frame the PC presented until the PC sends RELEASE
      or the keyboard restarts, so a crashed or unplugged app leaves the screen as it was.

config NICE_VIEW_ART_RELAY
    bool "Take right-hand art pushed from the PC through the left half"
    default y if ZMK_SPLIT_BLE && (NICE_VIEW_HOST_LINK || !ZMK_SPLIT_ROLE_CENTRAL)
    select CRC

config NICE_VIEW_RGB_IDLE
    bool "Underglow idle auto-off that survives a reboot; right half follows the left"
    default y if ZMK_RGB_UNDERGLOW
    depends on ZMK_RGB_UNDERGLOW && SETTINGS
    help
      Replaces ZMK_RGB_UNDERGLOW_AUTO_OFF_IDLE (set that to n), which saves its auto-off as the
      user's choice, so a half that reboots after idle (the right, waking from deep sleep) stays
      dark. With the art relay, the PC can make the right follow the left's state (0xD7 01).

config NICE_VIEW_RGB_BATTERY_DIM
    def_bool DT_HAS_FOXGLOVE_DIM_STRIP_ENABLED
    help
      The board's zmk,underglow is a foxglove,dim-strip in front of the real strip (the shield's
      boards/<board>.overlay), so dim_strip.c is built.

config NICE_VIEW_RGB_BATTERY_CAP
    int "Underglow brightness on battery, in percent (100 = no cap)"
    default 30
    range 1 100
    depends on NICE_VIEW_RGB_BATTERY_DIM
    help
      While a half has no USB power, its underglow is scaled to this much of what ZMK draws
      (#218). On the cable it's full brightness. ZMK's own brightness setting is unchanged.

config NICE_VIEW_ART_RELAY_MAX_SIZE
    int "Largest pushed art set, in bytes (RAM on both halves)"
    default 16384
    range 1024 65535

config ZMK_SPLIT_BLE_CENTRAL_BATTERY_LEVEL_FETCHING
    default y if NICE_VIEW_HOST_LINK

if !ZMK_SPLIT || ZMK_SPLIT_ROLE_CENTRAL

config NICE_VIEW_WIDGET_STATUS
    select LV_FONT_MONTSERRAT_18
    select LV_FONT_MONTSERRAT_14
    select LV_FONT_UNSCII_8
    select ZMK_WPM
    select ZMK_HID_INDICATORS

endif # !ZMK_SPLIT || ZMK_SPLIT_ROLE_CENTRAL

config ZMK_DISPLAY_STATUS_SCREEN_BUILT_IN
    select LV_FONT_MONTSERRAT_26

endif # SHIELD_NICE_VIEW_CUSTOM
```
